## base_external/package/chardev/Config.in
```kconfig
config BR2_PACKAGE_CHARDEV
	bool "chardev"
	help
	  Character linux Device drivers for assignments 8
```

## base_external/package/ldd/Config.in
```kconfig
config BR2_PACKAGE_LDD
	bool "ldd"
	help
	  Linux Device drivers for assignments 7 and later assignments
```
